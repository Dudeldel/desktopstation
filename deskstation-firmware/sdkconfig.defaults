## deskstation-firmware/sdkconfig.defaults
```kconfig
# Target
CONFIG_IDF_TARGET="esp32s3"

# USB CDC via TinyUSB
CONFIG_TINYUSB_CDC_ENABLED=y
CONFIG_TINYUSB_CDC_RX_BUFSIZE=2048
CONFIG_TINYUSB_CDC_TX_BUFSIZE=2048
# Bumped: on_cdc_rx callback runs in TinyUSB driver's task. Default 4 KB
# was overflowed by usb_line_t (now moved off-stack, but extra headroom
# keeps the driver task safe under heavy traffic).
CONFIG_TINYUSB_TASK_STACK_SIZE=8192

# PSRAM (octal, 8 MB on ESP32-S3-N16R8).
# 120 MHz needed for 16 MHz RGB pclk without DMA underrun (matches inytar ESPHome cfg).
# ESP-IDF only has MSPI tuning tables for {CPU 240M, flash 120M, PSRAM 120M} or
# {CPU 160M, flash 80M, PSRAM 80M} — must set all three together.
CONFIG_IDF_EXPERIMENTAL_FEATURES=y
CONFIG_SPIRAM=y
CONFIG_SPIRAM_MODE_OCT=y
CONFIG_SPIRAM_SPEED_120M=y
CONFIG_SPIRAM_USE_MALLOC=y
CONFIG_SPIRAM_MALLOC_ALWAYSINTERNAL=16384
# Move code + rodata into PSRAM. Espressif-recommended for RGB panels with
# framebuffer in PSRAM — frees internal SRAM bandwidth otherwise contended
# by instruction fetch competing with the panel's EDMA refresh.
CONFIG_SPIRAM_FETCH_INSTRUCTIONS=y
CONFIG_SPIRAM_RODATA=y
CONFIG_ESP_DEFAULT_CPU_FREQ_MHZ_240=y
CONFIG_ESPTOOLPY_FLASHFREQ_120M=y

# FreeRTOS
CONFIG_FREERTOS_HZ=1000
CONFIG_ESP_TASK_WDT_TIMEOUT_S=10
# Bumped: app_main puts 4 KB usb_line_t on stack via send_line; default 3584 overflows.
CONFIG_ESP_MAIN_TASK_STACK_SIZE=8192

# LVGL color depth 16 bpp.
# Built-in Montserrat fonts disabled — we ship our own Polish-glyph subset
# (main/ui/fonts/lv_font_pl_*.c), generated by tools/fonts/gen.sh.
CONFIG_LV_COLOR_DEPTH_16=y
# Route LVGL allocations through heap_caps (PSRAM-backed) instead of the
# fixed 32 KB TLSF pool. ESP-IDF's RGB-panel reference config uses this.
# Avoids the heap pressure that caused our earlier TLSF panic and lets the
# carousel + top bar + dots widgets coexist with M3+'s pomodoro overlay
# without worrying about LV_MEM_SIZE_KILOBYTES.
CONFIG_LV_MEM_CUSTOM=y
CONFIG_LV_MEMCPY_MEMSET_STD=y

# Flash size (16 MB)
CONFIG_ESPTOOLPY_FLASHSIZE_16MB=y
CONFIG_PARTITION_TABLE_CUSTOM=y
CONFIG_PARTITION_TABLE_CUSTOM_FILENAME="partitions.csv"

# Console — logs go to JTAG/UART debug port (NOT USB CDC, which is reserved for our protocol)
CONFIG_ESP_CONSOLE_UART_DEFAULT=y
```
